## block/Kconfig.iosched.rej
```kconfig
***************
*** 59,64 ****
  	---help---
  	  Requests are chosen according to SSTF with a penalty of rev_penalty
  	  for switching head direction.
  choice
  	prompt "Default I/O scheduler"
  	default DEFAULT_CFQ
--- 59,87 ----
  	---help---
  	  Requests are chosen according to SSTF with a penalty of rev_penalty
  	  for switching head direction.
+ 
+ config IOSCHED_BFQ
+ 	tristate "BFQ I/O scheduler"
+ 	depends on EXPERIMENTAL
+ 	default n
+ 	---help---
+ 	  The BFQ I/O scheduler tries to distribute bandwidth among
+ 	  all processes according to their weights.
+ 	  It aims at distributing the bandwidth as desired, independently of
+ 	  the disk parameters and with any workload. It also tries to
+ 	  guarantee low latency to interactive and soft real-time
+ 	  applications.  If compiled built-in (saying Y here), BFQ can
+ 	  be configured to support hierarchical scheduling.
+ 
+ config CGROUP_BFQIO
+ 	bool "BFQ hierarchical scheduling support"
+ 	depends on CGROUPS && IOSCHED_BFQ=y
+ 	default n
+ 	---help---
+ 	  Enable hierarchical scheduling in BFQ, using the cgroups
+ 	  filesystem interface.  The name of the subsystem will be
+ 	  bfqio.
+ 
  choice
  	prompt "Default I/O scheduler"
  	default DEFAULT_CFQ
```
